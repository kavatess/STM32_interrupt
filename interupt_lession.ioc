# file: interupt_lession.ioc
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Mcu.Family=STM32F1
RCC.APB2Freq_Value=8000000
PA14.Mode=Serial_Wire
PA13.Mode=Serial_Wire
Mcu.Name=STM32F103C(8-B)Tx
Mcu.Package=LQFP48
ProjectManager.StackSize=0x400
PA13.Signal=SYS_JTMS-SWDIO
PA14.Signal=SYS_JTCK-SWCLK
ProjectManager.HeapSize=0x200
ProjectManager.TargetToolchain=STM32CubeIDE
NVIC.PriorityGroup=NVIC_PRIORITYGROUP_4
RCC.APB1Freq_Value=8000000
board=custom

// file: Core/Src/main.c
/* USER CODE BEGIN Header */
/**
  ******************************************************************************
  * @file           : main.c
  * @brief          : Main program body
  ******************************************************************************
  * @attention
  *
  * <h2><center>&copy; Copyright (c) 2021 STMicroelectronics.
  * All rights reserved.</center></h2>
  *
  * This software component is licensed by ST under BSD 3-Clause license,
  * the "License"; You may not use this file except in compliance with the
  * License. You may obtain a copy of the License at:
  *                        opensource.org/licenses/BSD-3-Clause
  *
  ******************************************************************************
  */
/* USER CODE END Header */
#include "main.h"

/* USER CODE BEGIN Includes */
#include "stdint.h"
#include "string.h"
/* USER CODE END Includes */

/* USER CODE BEGIN PTD */
typedef struct GPIO {
	uint32_t ODR;
	uint32_t IDR;
	uint32_t CRL;
	uint32_t CRH;
};
/* USER CODE END PTD */

/* USER CODE BEGIN PV */
void Delay(uint32_t mSec){
	uint32_t timeOut=mSec*8000;
	for(int i=0;i<timeOut;i++){

	}
}
/* USER CODE END PV */

void SystemClock_Config(void);
static void MX_GPIO_Init(void);

/* USER CODE BEGIN 0 */
void EXTI15_10_IRQHandler(){
	uint32_t *EXTI_PR;
	EXTI_PR=0x40010414;
	*EXTI_PR|=(1<<11);

	uint32_t *GPIOB_CRL;
	GPIOB_CRL = 0x40010C00;
	*GPIOB_CRL &=~ (0b1111);
	*GPIOB_CRL |= 1;
	*GPIOB_CRL |= (1<<2);

	uint32_t *GPIOB_ODR;
	GPIOB_ODR=0x40010C0C;
	*GPIOB_ODR &= ~(0b1);
	Delay(500);
	*GPIOB0_ODR |= 1;
	Delay(500);
}
/* USER CODE END 0 */

int main(void)
{

  /* MCU Configuration--------------------------------------------------------*/

  /* Reset of all peripherals, Initializes the Flash interface and the Systick. */
  HAL_Init();

  /* Configure the system clock */
  SystemClock_Config();

  /* Initialize all configured peripherals */
  MX_GPIO_Init();
  /* USER CODE BEGIN 2 */
  /*uint32_t *GPIOA_CRH;
  GPIOA_CRH=0x40010804;
  *GPIOA_CRH|=(1<<15);
  *GPIOA_CRH&=~(111<<12);

  uint32_t *AFIO_EXTICR4;
  AFIO_EXTICR4=0x40010810;
  *AFIO_EXTICR4&=~(0xf<<12);

  uint32_t *EXTI11_RTSR;
  *EXTI11_RTSR*/
  __HAL_RCC_GPIOA_CLK_ENABLE();
  __HAL_RCC_GPIOB_CLK_ENABLE();

  uint32_t *NVIC_ISER1;
  NVIC_ISER1=0xE000E104;
 *NVIC_ISER1|=(1<<8);

  __HAL_RCC_AFIO_CLK_ENABLE();

  uint32_t *AFIO_EXTICR3;
  AFIO_EXTICR3=0x40010010;
  *AFIO_EXTICR3&=~(1111<<12);

  uint32_t *GPIOA_CRH;
  GPIOA_CRH=0x40010804;
  *GPIOA_CRH &= ~(1111<<12);
  *GPIOA_CRH |= (1<<15);

  uint32_t *GPIOA_ODR;
  GPIOA_ODR=0x4001080C;
  *GPIOA_ODR=(1<<11);

  uint32_t *EXTI_RTSR;
  EXTI_RTSR=0x40010408;
  *EXTI_RTSR=(1<<11);

  uint32_t *EXTI_IMR;
  EXTI_IMR=0x40010400;
  *EXTI_IMR|=(1<<11);

  /* USER CODE END 2 */

  /* Infinite loop */
  while (1)
  {

  }
}

void SystemClock_Config(void)
{
  RCC_OscInitTypeDef RCC_OscInitStruct = {0};
  RCC_ClkInitTypeDef RCC_ClkInitStruct = {0};

  /** Initializes the RCC Oscillators according to the specified parameters
  * in the RCC_OscInitTypeDef structure.
  */
  RCC_OscInitStruct.OscillatorType = RCC_OSCILLATORTYPE_HSI;
  RCC_OscInitStruct.HSIState = RCC_HSI_ON;
  RCC_OscInitStruct.HSICalibrationValue = RCC_HSICALIBRATION_DEFAULT;
  RCC_OscInitStruct.PLL.PLLState = RCC_PLL_NONE;
  if (HAL_RCC_OscConfig(&RCC_OscInitStruct) != HAL_OK)
  {
    Error_Handler();
  }
  /** Initializes the CPU, AHB and APB buses clocks
  */
  RCC_ClkInitStruct.ClockType = RCC_CLOCKTYPE_HCLK|RCC_CLOCKTYPE_SYSCLK
                              |RCC_CLOCKTYPE_PCLK1|RCC_CLOCKTYPE_PCLK2;
  RCC_ClkInitStruct.SYSCLKSource = RCC_SYSCLKSOURCE_HSI;
  RCC_ClkInitStruct.AHBCLKDivider = RCC_SYSCLK_DIV1;
  RCC_ClkInitStruct.APB1CLKDivider = RCC_HCLK_DIV1;
  RCC_ClkInitStruct.APB2CLKDivider = RCC_HCLK_DIV1;

  if (HAL_RCC_ClockConfig(&RCC_ClkInitStruct, FLASH_LATENCY_0) != HAL_OK)
  {
    Error_Handler();
  }
}

static void MX_GPIO_Init(void)
{

  /* GPIO Ports Clock Enable */
  __HAL_RCC_GPIOA_CLK_ENABLE();

}

void Error_Handler(void)
{
  __disable_irq();
  while (1)
  {
  }
}

/************************ (C) COPYRIGHT STMicroelectronics *****END OF FILE****/
